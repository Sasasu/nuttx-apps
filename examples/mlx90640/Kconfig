## examples/mlx90640/Kconfig
```kconfig
#
# For a description of the syntax of this configuration file,
# see the file kconfig-language.txt in the NuttX tools repository.
#

config EXAMPLES_MLX90640
	tristate "MLX90640"
	default n
	---help---
		should enable

if EXAMPLES_MLX90640

config EXAMPLES_MLX90640_PROGNAME
	string "Program name"
	default "mlx90640"
	---help---
		This is the name of the program that will be used when the NSH ELF
		program is installed.

config EXAMPLES_MLX90640_PRIORITY
	int "Hello task priority"
	default 100

config EXAMPLES_MLX90640_STACKSIZE
	int "Hello stack size"
	default DEFAULT_TASK_STACKSIZE

endif
```

## examples/power_manager/Kconfig
```kconfig
#
# For a description of the syntax of this configuration file,
# see the file kconfig-language.txt in the NuttX tools repository.
#

config EXAMPLES_POWER_MANAGER
	tristate "power manager"
	default n
	---help---
		should enable

if EXAMPLES_POWER_MANAGER

config EXAMPLES_POWER_MANAGER_PROGNAME
	string "Program name"
	default "powerd"
	---help---
		This is the name of the program that will be used when the NSH ELF
		program is installed.

config EXAMPLES_POWER_MANAGER_PRIORITY
	int "Hello task priority"
	default 100

config EXAMPLES_POWER_MANAGER_STACKSIZE
	int "Hello stack size"
	default DEFAULT_TASK_STACKSIZE

endif
```
